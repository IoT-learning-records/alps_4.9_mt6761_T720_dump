/dts-v1/;

/ {

	__fixups__ {
		accdet = "/fragment@8:target:0";
		alsps_mtk = "/fragment@16:target:0";
		audgpio = "/fragment@21:target:0";
		auxadc = "/fragment@25:target:0";
		charger = "/fragment@11:target:0";
		chosen = "/fragment@1:target:0";
		consys = "/fragment@20:target:0";
		cust_driver = "/fragment@56:target:0";
		dsi_te = "/fragment@43:target:0";
		gpio = "/fragment@38:target:0";
		gpio_usage_mapping = "/fragment@37:target:0";
		i2c0 = "/fragment@13:target:0", "/fragment@27:target:0";
		i2c1 = "/fragment@14:target:0", "/fragment@28:target:0";
		i2c2 = "/fragment@3:target:0", "/fragment@29:target:0";
		i2c3 = "/fragment@4:target:0", "/fragment@12:target:0", "/fragment@17:target:0", "/fragment@30:target:0";
		i2c4 = "/fragment@31:target:0";
		i2c5 = "/fragment@32:target:0";
		i2c6 = "/fragment@5:target:0", "/fragment@33:target:0";
		i2c7 = "/fragment@34:target:0";
		i2c8 = "/fragment@35:target:0";
		i2c9 = "/fragment@36:target:0";
		irq_nfc = "/fragment@40:target:0";
		kd_camera_hw1 = "/fragment@24:target:0", "/fragment@53:target:0";
		keypad = "/fragment@55:target:0";
		main_pmic = "/fragment@45:target:0";
		md1_sim1_hot_plug_eint = "/fragment@46:target:0";
		msdc1_ins = "/fragment@44:target:0";
		mt6370_pmu = "/fragment@10:target:0";
		mt6370_typec = "/fragment@18:target:0";
		mt_pmic_vaud28_ldo_reg = "/fragment@56/__overlay__:ldo_vaud28-supply:0";
		mt_pmic_vaux18_ldo_reg = "/fragment@56/__overlay__:ldo_vaux18-supply:0";
		mt_pmic_vcama_ldo_reg = "/fragment@47:target:0", "/fragment@53/__overlay__:vcama-supply:0", "/fragment@56/__overlay__:ldo_vcama-supply:0";
		mt_pmic_vcamd_ldo_reg = "/fragment@50:target:0", "/fragment@53/__overlay__:vcamd_main2-supply:0", "/fragment@56/__overlay__:ldo_vcamd-supply:0";
		mt_pmic_vcamio_ldo_reg = "/fragment@51:target:0", "/fragment@53/__overlay__:vcamio-supply:0", "/fragment@53/__overlay__:vcamio_sub-supply:0", "/fragment@53/__overlay__:vcamio_main2-supply:0", "/fragment@56/__overlay__:ldo_vcamio-supply:0";
		mt_pmic_vcn28_ldo_reg = "/fragment@56/__overlay__:ldo_vcn28-supply:0";
		mt_pmic_vcn33_bt_ldo_reg = "/fragment@56/__overlay__:ldo_vcn33_bt-supply:0";
		mt_pmic_vcn33_wifi_ldo_reg = "/fragment@56/__overlay__:ldo_vcn33_wifi-supply:0";
		mt_pmic_vdram_ldo_reg = "/fragment@56/__overlay__:ldo_vdram-supply:0";
		mt_pmic_vefuse_ldo_reg = "/fragment@56/__overlay__:ldo_vefuse-supply:0";
		mt_pmic_vemc_ldo_reg = "/fragment@56/__overlay__:ldo_vemc-supply:0";
		mt_pmic_vfe28_ldo_reg = "/fragment@56/__overlay__:ldo_vfe28-supply:0";
		mt_pmic_vibr_ldo_reg = "/fragment@56/__overlay__:ldo_vibr-supply:0";
		mt_pmic_vio18_ldo_reg = "/fragment@56/__overlay__:ldo_vio18-supply:0";
		mt_pmic_vio28_ldo_reg = "/fragment@56/__overlay__:ldo_vio28-supply:0";
		mt_pmic_vldo28_ldo_reg = "/fragment@52:target:0", "/fragment@53/__overlay__:vcamaf-supply:0", "/fragment@53/__overlay__:vcamaf_sub-supply:0", "/fragment@53/__overlay__:vcamaf_main2-supply:0", "/fragment@54/__overlay__:vtouch-supply:0", "/fragment@56/__overlay__:ldo_vldo28-supply:0";
		mt_pmic_vmc_ldo_reg = "/fragment@56/__overlay__:ldo_vmc-supply:0";
		mt_pmic_vmch_ldo_reg = "/fragment@56/__overlay__:ldo_vmch-supply:0";
		mt_pmic_vrf12_ldo_reg = "/fragment@56/__overlay__:ldo_vrf12-supply:0";
		mt_pmic_vrf18_ldo_reg = "/fragment@56/__overlay__:ldo_vrf18-supply:0";
		mt_pmic_vsim1_ldo_reg = "/fragment@48:target:0", "/fragment@56/__overlay__:ldo_vsim1-supply:0";
		mt_pmic_vsim2_ldo_reg = "/fragment@49:target:0", "/fragment@56/__overlay__:ldo_vsim2-supply:0";
		mt_pmic_vsram_others_ldo_reg = "/fragment@56/__overlay__:ldo_vsram_others-supply:0";
		mt_pmic_vsram_proc_ldo_reg = "/fragment@56/__overlay__:ldo_vsram_proc-supply:0";
		mt_pmic_vusb33_ldo_reg = "/fragment@56/__overlay__:ldo_vusb33-supply:0";
		mt_pmic_vxo22_ldo_reg = "/fragment@56/__overlay__:ldo_vxo22-supply:0";
		odm = "/fragment@2:target:0";
		pio = "/fragment@7:target:0", "/fragment@9:target:0", "/fragment@10/__overlay__:mt6370,intr_gpio:0", "/fragment@12/__overlay__/rt9465@4b:rt,en_gpio:0", "/fragment@12/__overlay__/rt9465@4b:rt,intr_gpio:0", "/fragment@15:target:0", "/fragment@17/__overlay__/alsps@49:interrupt-parent:0", "/fragment@18/__overlay__:mt6370pd,intr_gpio:0", "/fragment@19:target:0", "/fragment@22:target:0", "/fragment@23:target:0", "/fragment@37/__overlay__:GPIO_SIM2_SIO:0", "/fragment@37/__overlay__:GPIO_SIM2_SRST:0", "/fragment@37/__overlay__:GPIO_SIM2_SCLK:0", "/fragment@37/__overlay__:GPIO_SIM1_SCLK:0", "/fragment@37/__overlay__:GPIO_SIM1_SRST:0", "/fragment@37/__overlay__:GPIO_SIM1_SIO:0", "/fragment@37/__overlay__:GPIO_SIM1_HOT_PLUG:0", "/fragment@39/__overlay__:interrupt-parent:0", "/fragment@40/__overlay__:interrupt-parent:0", "/fragment@41/__overlay__:interrupt-parent:0", "/fragment@42/__overlay__:interrupt-parent:0", "/fragment@43/__overlay__:interrupt-parent:0", "/fragment@44/__overlay__:interrupt-parent:0", "/fragment@45/__overlay__:interrupt-parent:0", "/fragment@56/__overlay__:gpio-base:0", "/fragment@56/__overlay__:interrupt-parent:0", "/fragment@56/__overlay__/gpio-keys/scan:interrupt-parent:0", "/fragment@56/__overlay__/gpio-switch-dev/eint_switch1:interrupt-parent:0";
		pmic_clock_buffer_ctrl = "/fragment@26:target:0";
		reserved_memory = "/fragment@0:target:0";
		subpmic_pmu_eint = "/fragment@41:target:0";
		tcpc_pd = "/fragment@42:target:0";
		touch = "/fragment@6:target:0", "/fragment@39:target:0", "/fragment@54:target:0";
	};

	__local_fixups__ {

		fragment@16 {

			__overlay__ {
				pinctrl-0 = <0x0>;
				pinctrl-1 = <0x0>;
			};
		};

		fragment@20 {

			__overlay__ {
				pinctrl-0 = <0x0>;
				pinctrl-1 = <0x0>;
				pinctrl-2 = <0x0>;
				pinctrl-3 = <0x0>;
			};
		};

		fragment@21 {

			__overlay__ {
				pinctrl-0 = <0x0>;
				pinctrl-1 = <0x0>;
				pinctrl-2 = <0x0>;
				pinctrl-3 = <0x0>;
				pinctrl-4 = <0x0>;
				pinctrl-5 = <0x0>;
				pinctrl-6 = <0x0>;
				pinctrl-7 = <0x0>;
				pinctrl-8 = <0x0>;
				pinctrl-9 = <0x0>;
			};
		};

		fragment@24 {

			__overlay__ {
				pinctrl-0 = <0x0>;
				pinctrl-1 = <0x0>;
				pinctrl-10 = <0x0>;
				pinctrl-11 = <0x0>;
				pinctrl-12 = <0x0>;
				pinctrl-13 = <0x0>;
				pinctrl-14 = <0x0>;
				pinctrl-15 = <0x0>;
				pinctrl-16 = <0x0>;
				pinctrl-17 = <0x0>;
				pinctrl-18 = <0x0>;
				pinctrl-19 = <0x0>;
				pinctrl-2 = <0x0>;
				pinctrl-20 = <0x0>;
				pinctrl-21 = <0x0>;
				pinctrl-22 = <0x0>;
				pinctrl-23 = <0x0>;
				pinctrl-24 = <0x0>;
				pinctrl-25 = <0x0>;
				pinctrl-26 = <0x0>;
				pinctrl-3 = <0x0>;
				pinctrl-4 = <0x0>;
				pinctrl-5 = <0x0>;
				pinctrl-6 = <0x0>;
				pinctrl-7 = <0x0>;
				pinctrl-8 = <0x0>;
				pinctrl-9 = <0x0>;
			};
		};

		fragment@6 {

			__overlay__ {
				pinctrl-0 = <0x0>;
				pinctrl-1 = <0x0>;
				pinctrl-2 = <0x0>;
				pinctrl-3 = <0x0>;
				pinctrl-4 = <0x0>;
				pinctrl-5 = <0x0>;
			};
		};

		fragment@8 {

			__overlay__ {
				pinctrl-0 = <0x0>;
				pinctrl-1 = <0x0>;
			};
		};
	};

	__symbols__ {
		accdet_pins_default = "/fragment@9/__overlay__/accdetdefault";
		accdet_pins_eint_as_int = "/fragment@9/__overlay__/accdeteint@0";
		alsps_intpin_cfg = "/fragment@15/__overlay__/alspspincfg";
		alsps_intpin_default = "/fragment@15/__overlay__/alspsdefaultcfg";
		aud_clk_miso_off = "/fragment@22/__overlay__/aud_clk_miso_off";
		aud_clk_miso_on = "/fragment@22/__overlay__/aud_clk_miso_on";
		aud_clk_mosi_off = "/fragment@22/__overlay__/aud_clk_mosi_off";
		aud_clk_mosi_on = "/fragment@22/__overlay__/aud_clk_mosi_on";
		aud_dat_miso_off = "/fragment@22/__overlay__/aud_dat_miso_off";
		aud_dat_miso_on = "/fragment@22/__overlay__/aud_dat_miso_on";
		aud_dat_mosi_off = "/fragment@22/__overlay__/aud_dat_mosi_off";
		aud_dat_mosi_on = "/fragment@22/__overlay__/aud_dat_mosi_on";
		aud_pins_smartpa_off = "/fragment@22/__overlay__/aud_pins_smartpa_off";
		aud_pins_smartpa_on = "/fragment@22/__overlay__/aud_pins_smartpa_on";
		camera_main_af_mtk = "/fragment@29/__overlay__/camera_main_af@0c";
		camera_main_eeprom_mtk = "/fragment@29/__overlay__/camera_main_eeprom@50";
		camera_main_mtk = "/fragment@29/__overlay__/camera_main@1a";
		camera_main_two_af_mtk = "/fragment@33/__overlay__/camera_main_two_af@0c";
		camera_main_two_eeprom_mtk = "/fragment@33/__overlay__/camera_main_two_eeprom@50";
		camera_main_two_mtk = "/fragment@33/__overlay__/camera_main_two@2d";
		camera_pins_cam0_mclk_off = "/fragment@23/__overlay__/camera_pins_cam0_mclk_off";
		camera_pins_cam0_mclk_on = "/fragment@23/__overlay__/camera_pins_cam0_mclk_on";
		camera_pins_cam0_pnd0 = "/fragment@23/__overlay__/cam0@2";
		camera_pins_cam0_pnd1 = "/fragment@23/__overlay__/cam0@3";
		camera_pins_cam0_rst0 = "/fragment@23/__overlay__/cam0@0";
		camera_pins_cam0_rst1 = "/fragment@23/__overlay__/cam0@1";
		camera_pins_cam1_mclk_off = "/fragment@23/__overlay__/camera_pins_cam1_mclk_off";
		camera_pins_cam1_mclk_on = "/fragment@23/__overlay__/camera_pins_cam1_mclk_on";
		camera_pins_cam1_pnd0 = "/fragment@23/__overlay__/cam1@2";
		camera_pins_cam1_pnd1 = "/fragment@23/__overlay__/cam1@3";
		camera_pins_cam1_rst0 = "/fragment@23/__overlay__/cam1@0";
		camera_pins_cam1_rst1 = "/fragment@23/__overlay__/cam1@1";
		camera_pins_cam2_mclk_off = "/fragment@23/__overlay__/camera_pins_cam2_mclk_off";
		camera_pins_cam2_mclk_on = "/fragment@23/__overlay__/camera_pins_cam2_mclk_on";
		camera_pins_cam2_pnd0 = "/fragment@23/__overlay__/cam2@2";
		camera_pins_cam2_pnd1 = "/fragment@23/__overlay__/cam2@3";
		camera_pins_cam2_rst0 = "/fragment@23/__overlay__/cam2@0";
		camera_pins_cam2_rst1 = "/fragment@23/__overlay__/cam2@1";
		camera_pins_cam_ldo_rear2_vcama_0 = "/fragment@23/__overlay__/cam2@vcama0";
		camera_pins_cam_ldo_rear2_vcama_1 = "/fragment@23/__overlay__/cam2@vcama1";
		camera_pins_cam_ldo_rear_vcamd_0 = "/fragment@23/__overlay__/cam0@vcamd0";
		camera_pins_cam_ldo_rear_vcamd_1 = "/fragment@23/__overlay__/cam0@vcamd1";
		camera_pins_cam_ldo_sub_vcama_0 = "/fragment@23/__overlay__/cam1@vcama0";
		camera_pins_cam_ldo_sub_vcama_1 = "/fragment@23/__overlay__/cam1@vcama1";
		camera_pins_cam_ldo_sub_vcamd_0 = "/fragment@23/__overlay__/cam1@vcamd0";
		camera_pins_cam_ldo_sub_vcamd_1 = "/fragment@23/__overlay__/cam1@vcamd1";
		camera_pins_default = "/fragment@23/__overlay__/camdefault";
		camera_sub_eeprom_mtk = "/fragment@31/__overlay__/camera_sub_eeprom@52";
		camera_sub_mtk = "/fragment@31/__overlay__/camera_sub@2d";
		cap_touch_mtk = "/fragment@27/__overlay__/cap_touch@5d";
		consys_pins_default = "/fragment@19/__overlay__/consys_default";
		ctp_pins_default = "/fragment@7/__overlay__/eint0default";
		ctp_pins_eint_as_int = "/fragment@7/__overlay__/eint@0";
		ctp_pins_eint_output0 = "/fragment@7/__overlay__/eintoutput0";
		ctp_pins_eint_output1 = "/fragment@7/__overlay__/eintoutput1";
		ctp_pins_rst_output0 = "/fragment@7/__overlay__/rstoutput0";
		ctp_pins_rst_output1 = "/fragment@7/__overlay__/rstoutput1";
		ext_buck_lp4_mtk = "/fragment@30/__overlay__/ext_buck_lp4@57";
		ext_buck_lp4x_mtk = "/fragment@30/__overlay__/ext_buck_lp4x@50";
		ext_buck_vgpu_mtk = "/fragment@33/__overlay__/ext_buck_vgpu@55";
		gpslna_pins_init = "/fragment@19/__overlay__/gpslna@0";
		gpslna_pins_oh = "/fragment@19/__overlay__/gpslna@1";
		gpslna_pins_ol = "/fragment@19/__overlay__/gpslna@2";
		gsensor_mtk = "/fragment@28/__overlay__/gsensor@0e";
		led0 = "/fragment@2/__overlay__/led@0";
		led1 = "/fragment@2/__overlay__/led@1";
		led2 = "/fragment@2/__overlay__/led@2";
		led3 = "/fragment@2/__overlay__/led@3";
		led4 = "/fragment@2/__overlay__/led@4";
		led5 = "/fragment@2/__overlay__/led@5";
		led6 = "/fragment@2/__overlay__/led@6";
		lsm6ds3_acc = "/fragment@2/__overlay__/lsm6ds3_acc@6a";
		lsm6ds3_gyro = "/fragment@2/__overlay__/lsm6ds3_gyro@6a";
		memory_ssmr_features = "/fragment@2/__overlay__/memory-ssmr-features";
		nfc_mtk = "/fragment@30/__overlay__/nfc@08";
		scancontrol_i2c_mtk = "/fragment@31/__overlay__/scancontrol_i2c@64";
		slave_charger_mtk = "/fragment@30/__overlay__/slave_charger@4b";
		subpmic_pmu_mtk = "/fragment@32/__overlay__/subpmic_pmu@34";
		usb_type_c_mtk = "/fragment@32/__overlay__/usb_type_c@4e";
		vibrator0 = "/fragment@2/__overlay__/vibrator@0";
	};

	fragment@0 {
		target = <0xffffffff>;

		__overlay__ {
			#address-cells = <0x2>;
			#size-cells = <0x2>;
			ranges;

			zmc-default {
				alignment = <0x0 0x10000000>;
				alloc-ranges = <0x0 0xc0000000 0x1 0x0>;
				compatible = "mediatek,zone_movable_cma";
				size = <0x0 0xffc00000>;
			};
		};
	};

	fragment@1 {
		target = <0xffffffff>;

		__overlay__ {
			atag,videolfb-fb_base_h = <0x0>;
			atag,videolfb-fb_base_l = "^`P";
			atag,videolfb-fps = <0x1770>;
			atag,videolfb-islcm_inited = <0x0>;
			atag,videolfb-islcmfound = <0x1>;
			atag,videolfb-lcmname = "nt35521_hd_dsi_vdo_truly_rt5081_drv";
			atag,videolfb-vramSize = <0x17bb000>;
		};
	};

	fragment@10 {
		target = <0xffffffff>;

		__overlay__ {
			mt6370,intr_gpio = <0xffffffff 0xb 0x0>;
			mt6370,intr_gpio_num = <0xb>;
		};
	};

	fragment@11 {
		target = <0xffffffff>;

		__overlay__ {
			chg1_ta_ac_charger_current = <0x1e8480>;
			chg2_ta_ac_charger_current = <0x1e8480>;
		};
	};

	fragment@12 {
		target = <0xffffffff>;

		__overlay__ {

			rt9465@4b {
				charger_name = "secondary_chg";
				compatible = "richtek,rt9465";
				cv = <0x456d70>;
				en_st;
				en_wdt;
				ichg = <0x16e360>;
				ieoc = <0xaae60>;
				interrupt-names = "wdtmri";
				mivr = <0x44aa20>;
				reg = <0x4b>;
				rt,en_gpio = <0xffffffff 0xb0 0x0>;
				rt,en_gpio_num = <0xb0>;
				rt,intr_gpio = <0xffffffff 0x17 0x0>;
				rt,intr_gpio_num = <0x17>;
				safety_timer = <0xc>;
				status = "okay";
			};
		};
	};

	fragment@13 {
		target = <0xffffffff>;

		__overlay__ {

			cap_touch@5d {
				compatible = "mediatek,gt1xx";
				reg = <0x5d>;
				status = "okay";
			};
		};
	};

	fragment@14 {
		target = <0xffffffff>;

		__overlay__ {

			gsensor@0e {
				direction = <0x7>;
				firlen = <0x0>;
				i2c_addr = <0xe 0x0 0x0 0x0>;
				i2c_num = <0x1>;
				is_batch_supported = <0x0>;
				power_id = <0xffff>;
				power_vol = <0x0>;
			};
		};
	};

	fragment@15 {
		target = <0xffffffff>;

		__overlay__ {

			alspsdefaultcfg {
				linux,phandle = <0x9>;
				phandle = <0x9>;
			};

			alspspincfg {
				linux,phandle = <0xa>;
				phandle = <0xa>;

				pins_cmd_dat {
					bias-pull-up;
					pinmux = <0x900>;
					slew-rate = <0x0>;
				};
			};
		};
	};

	fragment@16 {
		target = <0xffffffff>;

		__overlay__ {
			pinctrl-0 = <0x9>;
			pinctrl-1 = <0xa>;
			pinctrl-names = "pin_default", "pin_cfg";
			status = "okay";
		};
	};

	fragment@17 {
		target = <0xffffffff>;

		__overlay__ {

			alsps@49 {
				als_level = <0x0 0x7d 0x13f 0x20d 0x443 0x9b0 0xbf2 0x13fb 0x218d 0x2a11 0x3239 0x458f 0x564b 0xffff 0xffff>;
				als_value = <0x0 0x85 0x12f 0x1f8 0x3ea 0x7d3 0xbbe 0x138b 0x1f42 0x2710 0x2ee0 0x3e80 0x4e20 0x4e20 0x4e20 0x4e20>;
				compatible = "mediatek,alsps_epl259x";
				i2c_addr = <0x49 0x0 0x0 0x0>;
				i2c_num = <0x3>;
				interrupt-parent = <0xffffffff>;
				interrupts = <0x9 0x8 0x9 0x0>;
				is_batch_supported_als = <0x0>;
				is_batch_supported_ps = <0x0>;
				polling_mode_als = <0x1>;
				polling_mode_ps = <0x0>;
				power_id = <0xffff>;
				power_vol = <0x0>;
				ps_threshold_high = <0x7d0>;
				ps_threshold_low = <0x190>;
				reg = <0x49>;
				status = "okay";
			};

			gyro@6a {
				compatible = "mediatek,gyro_lsm6ds3";
				i2c_addr = <0x6a 0x0 0x0 0x0>;
				i2c_num = <0x3>;
				reg = <0x6a>;
				status = "okay";
			};
		};
	};

	fragment@18 {
		target = <0xffffffff>;

		__overlay__ {
			mt6370pd,intr_gpio = <0xffffffff 0x29 0x0>;
			mt6370pd,intr_gpio_num = <0x29>;
		};
	};

	fragment@19 {
		target = <0xffffffff>;

		__overlay__ {

			consys_default {
				linux,phandle = <0xb>;
				phandle = <0xb>;
			};

			gpslna@0 {
				linux,phandle = <0xc>;
				phandle = <0xc>;

				pins_cmd_dat {
					bias-disable;
					output-low;
					pinmux = <0x300>;
					slew-rate = <0x0>;
				};
			};

			gpslna@1 {
				linux,phandle = <0xd>;
				phandle = <0xd>;

				pins_cmd_dat {
					output-high;
					pinmux = <0x300>;
					slew-rate = <0x1>;
				};
			};

			gpslna@2 {
				linux,phandle = <0xe>;
				phandle = <0xe>;

				pins_cmd_dat {
					output-low;
					pinmux = <0x300>;
					slew-rate = <0x1>;
				};
			};
		};
	};

	fragment@2 {
		target = <0xffffffff>;

		__overlay__ {

			led@0 {
				compatible = "mediatek,red";
				data = <0x1>;
				led_mode = <0x0>;
				linux,phandle = <0x34>;
				phandle = <0x34>;
				pwm_config = <0x0 0x0 0x0 0x0 0x0>;
			};

			led@1 {
				compatible = "mediatek,green";
				data = <0x1>;
				led_mode = <0x0>;
				linux,phandle = <0x35>;
				phandle = <0x35>;
				pwm_config = <0x0 0x0 0x0 0x0 0x0>;
			};

			led@2 {
				compatible = "mediatek,blue";
				data = <0x1>;
				led_mode = <0x0>;
				linux,phandle = <0x36>;
				phandle = <0x36>;
				pwm_config = <0x0 0x0 0x0 0x0 0x0>;
			};

			led@3 {
				compatible = "mediatek,jogball-backlight";
				data = <0x1>;
				led_mode = <0x0>;
				linux,phandle = <0x37>;
				phandle = <0x37>;
				pwm_config = <0x0 0x0 0x0 0x0 0x0>;
			};

			led@4 {
				compatible = "mediatek,keyboard-backlight";
				data = <0x1>;
				led_mode = <0x0>;
				linux,phandle = <0x38>;
				phandle = <0x38>;
				pwm_config = <0x0 0x0 0x0 0x0 0x0>;
			};

			led@5 {
				compatible = "mediatek,button-backlight";
				data = <0x1>;
				led_mode = <0x0>;
				linux,phandle = <0x39>;
				phandle = <0x39>;
				pwm_config = <0x0 0x0 0x0 0x0 0x0>;
			};

			led@6 {
				compatible = "mediatek,lcd-backlight";
				data = <0x1>;
				led_mode = <0x5>;
				linux,phandle = <0x3a>;
				phandle = <0x3a>;
				pwm_config = <0x0 0x3 0x0 0x0 0x0>;
			};

			lsm6ds3_acc@6a {
				compatible = "mediatek,lsm6ds3_acc";
				direction = <0x6>;
				firlen = <0x0>;
				i2c_num = <0x3>;
				is_batch_supported = <0x0>;
				linux,phandle = <0x3e>;
				phandle = <0x3e>;
				power_id = <0xffff>;
				power_vol = <0x0>;
			};

			lsm6ds3_gyro@6a {
				compatible = "mediatek,lsm6ds3_gyro";
				direction = <0x5>;
				firlen = <0x0>;
				i2c_num = <0x1>;
				is_batch_supported = <0x0>;
				linux,phandle = <0x3d>;
				phandle = <0x3d>;
				power_id = <0xffff>;
				power_vol = <0x0>;
			};

			memory-ssmr-features {
				2d_fr-size = <0x0 0x0>;
				compatible = "mediatek,memory-ssmr-features";
				iris-recognition-size = <0x0 0x0>;
				linux,phandle = <0x3c>;
				phandle = <0x3c>;
				prot-sharedmem-size = <0x0 0x0>;
				svp-size = <0x0 0x0>;
				tui-size = <0x0 0x0>;
				wfd-size = <0x0 0x0>;
			};

			vibrator@0 {
				compatible = "mediatek,vibrator";
				linux,phandle = <0x3b>;
				phandle = <0x3b>;
				vib_limit = <0x9>;
				vib_timer = <0x19>;
				vib_vol = <0x9>;
			};
		};
	};

	fragment@20 {
		target = <0xffffffff>;

		__overlay__ {
			pinctrl-0 = <0xb>;
			pinctrl-1 = <0xc>;
			pinctrl-2 = <0xd>;
			pinctrl-3 = <0xe>;
			pinctrl-names = "default", "gps_lna_state_init", "gps_lna_state_oh", "gps_lna_state_ol";
			status = "okay";
		};
	};

	fragment@21 {
		target = <0xffffffff>;

		__overlay__ {
			pinctrl-0 = <0xf>;
			pinctrl-1 = <0x10>;
			pinctrl-2 = <0x11>;
			pinctrl-3 = <0x12>;
			pinctrl-4 = <0x13>;
			pinctrl-5 = <0x14>;
			pinctrl-6 = <0x15>;
			pinctrl-7 = <0x16>;
			pinctrl-8 = <0x17>;
			pinctrl-9 = <0x18>;
			pinctrl-names = "aud_clk_mosi_off", "aud_clk_mosi_on", "aud_clk_miso_off", "aud_clk_miso_on", "aud_dat_mosi_off", "aud_dat_mosi_on", "aud_dat_miso_off", "aud_dat_miso_on", "aud_smartpa_off", "aud_smartpa_on";
			status = "okay";
		};
	};

	fragment@22 {
		target = <0xffffffff>;

		__overlay__ {

			aud_clk_miso_off {
				linux,phandle = <0x11>;
				phandle = <0x11>;

				pins_cmd0_dat {
					pinmux = <0x8c00>;
				};
			};

			aud_clk_miso_on {
				linux,phandle = <0x12>;
				phandle = <0x12>;

				pins_cmd0_dat {
					pinmux = <0x8c01>;
				};
			};

			aud_clk_mosi_off {
				linux,phandle = <0xf>;
				phandle = <0xf>;

				pins_cmd0_dat {
					pinmux = <0x8800>;
				};
			};

			aud_clk_mosi_on {
				linux,phandle = <0x10>;
				phandle = <0x10>;

				pins_cmd0_dat {
					pinmux = <0x8801>;
				};
			};

			aud_dat_miso_off {
				linux,phandle = <0x15>;
				phandle = <0x15>;

				pins_cmd1_dat {
					bias-disable;
					input-enable;
					pinmux = <0x8e00>;
					slew-rate = <0x0>;
				};

				pins_cmd2_dat {
					bias-disable;
					input-enable;
					pinmux = <0x8f00>;
					slew-rate = <0x0>;
				};
			};

			aud_dat_miso_on {
				linux,phandle = <0x16>;
				phandle = <0x16>;

				pins_cmd1_dat {
					pinmux = <0x8e01>;
				};

				pins_cmd2_dat {
					pinmux = <0x8f01>;
				};
			};

			aud_dat_mosi_off {
				linux,phandle = <0x13>;
				phandle = <0x13>;

				pins_cmd1_dat {
					bias-disable;
					input-enable;
					pinmux = <0x8a00>;
					slew-rate = <0x0>;
				};

				pins_cmd2_dat {
					bias-disable;
					input-enable;
					pinmux = <0x8b00>;
					slew-rate = <0x0>;
				};
			};

			aud_dat_mosi_on {
				linux,phandle = <0x14>;
				phandle = <0x14>;

				pins_cmd1_dat {
					pinmux = <0x8a01>;
				};

				pins_cmd2_dat {
					pinmux = <0x8b01>;
				};
			};

			aud_pins_smartpa_off {
				linux,phandle = <0x17>;
				phandle = <0x17>;

				pins_cmd0_dat {
					pinmux = <0x1100>;
				};

				pins_cmd1_dat {
					pinmux = <0x1200>;
				};

				pins_cmd2_dat {
					pinmux = <0x1300>;
				};

				pins_cmd3_dat {
					pinmux = <0x1400>;
				};
			};

			aud_pins_smartpa_on {
				linux,phandle = <0x18>;
				phandle = <0x18>;

				pins_cmd0_dat {
					pinmux = <0x1106>;
				};

				pins_cmd1_dat {
					pinmux = <0x1206>;
				};

				pins_cmd2_dat {
					pinmux = <0x1306>;
				};

				pins_cmd3_dat {
					pinmux = <0x1406>;
				};
			};
		};
	};

	fragment@23 {
		target = <0xffffffff>;

		__overlay__ {

			cam0@0 {
				linux,phandle = <0x1a>;
				phandle = <0x1a>;

				pins_cmd_dat {
					output-low;
					pinmux = <0x6500>;
					slew-rate = <0x1>;
				};
			};

			cam0@1 {
				linux,phandle = <0x1b>;
				phandle = <0x1b>;

				pins_cmd_dat {
					output-high;
					pinmux = <0x6500>;
					slew-rate = <0x1>;
				};
			};

			cam0@2 {
				linux,phandle = <0x1c>;
				phandle = <0x1c>;

				pins_cmd_dat {
					output-low;
					pinmux = <0x6100>;
					slew-rate = <0x1>;
				};
			};

			cam0@3 {
				linux,phandle = <0x1d>;
				phandle = <0x1d>;

				pins_cmd_dat {
					output-high;
					pinmux = <0x6100>;
					slew-rate = <0x1>;
				};
			};

			cam0@vcamd0 {
				linux,phandle = <0x27>;
				phandle = <0x27>;

				pins_cmd_dat {
					output-low;
					pinmux = <0x5800>;
					slew-rate = <0x1>;
				};
			};

			cam0@vcamd1 {
				linux,phandle = <0x26>;
				phandle = <0x26>;

				pins_cmd_dat {
					output-high;
					pinmux = <0x5800>;
					slew-rate = <0x1>;
				};
			};

			cam1@0 {
				linux,phandle = <0x1e>;
				phandle = <0x1e>;

				pins_cmd_dat {
					output-low;
					pinmux = <0x6600>;
					slew-rate = <0x1>;
				};
			};

			cam1@1 {
				linux,phandle = <0x1f>;
				phandle = <0x1f>;

				pins_cmd_dat {
					output-high;
					pinmux = <0x6600>;
					slew-rate = <0x1>;
				};
			};

			cam1@2 {
				linux,phandle = <0x20>;
				phandle = <0x20>;

				pins_cmd_dat {
					output-low;
					pinmux = <0xad00>;
					slew-rate = <0x1>;
				};
			};

			cam1@3 {
				linux,phandle = <0x21>;
				phandle = <0x21>;

				pins_cmd_dat {
					output-high;
					pinmux = <0xad00>;
					slew-rate = <0x1>;
				};
			};

			cam1@vcama0 {
				linux,phandle = <0x2b>;
				phandle = <0x2b>;

				pins_cmd_dat {
					output-low;
					pinmux = <0xa800>;
					slew-rate = <0x1>;
				};
			};

			cam1@vcama1 {
				linux,phandle = <0x2a>;
				phandle = <0x2a>;

				pins_cmd_dat {
					output-high;
					pinmux = <0xa800>;
					slew-rate = <0x1>;
				};
			};

			cam1@vcamd0 {
				linux,phandle = <0x29>;
				phandle = <0x29>;

				pins_cmd_dat {
					output-low;
					pinmux = <0xaa00>;
					slew-rate = <0x1>;
				};
			};

			cam1@vcamd1 {
				linux,phandle = <0x28>;
				phandle = <0x28>;

				pins_cmd_dat {
					output-high;
					pinmux = <0xaa00>;
					slew-rate = <0x1>;
				};
			};

			cam2@0 {
				linux,phandle = <0x22>;
				phandle = <0x22>;

				pins_cmd_dat {
					output-low;
					pinmux = <0x5700>;
					slew-rate = <0x1>;
				};
			};

			cam2@1 {
				linux,phandle = <0x23>;
				phandle = <0x23>;

				pins_cmd_dat {
					output-high;
					pinmux = <0x5700>;
					slew-rate = <0x1>;
				};
			};

			cam2@2 {
				linux,phandle = <0x24>;
				phandle = <0x24>;

				pins_cmd_dat {
					output-low;
					pinmux = <0xa000>;
					slew-rate = <0x1>;
				};
			};

			cam2@3 {
				linux,phandle = <0x25>;
				phandle = <0x25>;

				pins_cmd_dat {
					output-high;
					pinmux = <0xa000>;
					slew-rate = <0x1>;
				};
			};

			cam2@vcama0 {
				linux,phandle = <0x2d>;
				phandle = <0x2d>;

				pins_cmd_dat {
					output-low;
					pinmux = <0x9f00>;
					slew-rate = <0x1>;
				};
			};

			cam2@vcama1 {
				linux,phandle = <0x2c>;
				phandle = <0x2c>;

				pins_cmd_dat {
					output-high;
					pinmux = <0x9f00>;
					slew-rate = <0x1>;
				};
			};

			camdefault {
				linux,phandle = <0x19>;
				phandle = <0x19>;
			};

			camera_pins_cam0_mclk_off {
				linux,phandle = <0x2f>;
				phandle = <0x2f>;

				pins_cmd_dat {
					pinmux = <0x6300>;
				};
			};

			camera_pins_cam0_mclk_on {
				linux,phandle = <0x2e>;
				phandle = <0x2e>;

				pins_cmd_dat {
					pinmux = <0x6301>;
				};
			};

			camera_pins_cam1_mclk_off {
				linux,phandle = <0x31>;
				phandle = <0x31>;

				pins_cmd_dat {
					pinmux = <0x6400>;
				};
			};

			camera_pins_cam1_mclk_on {
				linux,phandle = <0x30>;
				phandle = <0x30>;

				pins_cmd_dat {
					pinmux = <0x6401>;
				};
			};

			camera_pins_cam2_mclk_off {
				linux,phandle = <0x33>;
				phandle = <0x33>;

				pins_cmd_dat {
					pinmux = <0x6c00>;
				};
			};

			camera_pins_cam2_mclk_on {
				linux,phandle = <0x32>;
				phandle = <0x32>;

				pins_cmd_dat {
					pinmux = <0x6c01>;
				};
			};
		};
	};

	fragment@24 {
		target = <0xffffffff>;

		__overlay__ {
			pinctrl-0 = <0x19>;
			pinctrl-1 = <0x1a>;
			pinctrl-10 = <0x23>;
			pinctrl-11 = <0x24>;
			pinctrl-12 = <0x25>;
			pinctrl-13 = <0x26>;
			pinctrl-14 = <0x27>;
			pinctrl-15 = <0x28>;
			pinctrl-16 = <0x29>;
			pinctrl-17 = <0x2a>;
			pinctrl-18 = <0x2b>;
			pinctrl-19 = <0x2c>;
			pinctrl-2 = <0x1b>;
			pinctrl-20 = <0x2d>;
			pinctrl-21 = <0x2e>;
			pinctrl-22 = <0x2f>;
			pinctrl-23 = <0x30>;
			pinctrl-24 = <0x31>;
			pinctrl-25 = <0x32>;
			pinctrl-26 = <0x33>;
			pinctrl-3 = <0x1c>;
			pinctrl-4 = <0x1d>;
			pinctrl-5 = <0x1e>;
			pinctrl-6 = <0x1f>;
			pinctrl-7 = <0x20>;
			pinctrl-8 = <0x21>;
			pinctrl-9 = <0x22>;
			pinctrl-names = "default", "cam0_rst0", "cam0_rst1", "cam0_pnd0", "cam0_pnd1", "cam1_rst0", "cam1_rst1", "cam1_pnd0", "cam1_pnd1", "cam2_rst0", "cam2_rst1", "cam2_pnd0", "cam2_pnd1", "cam0_vcamd_on", "cam0_vcamd_off", "cam1_vcamd_on", "cam1_vcamd_off", "cam1_vcama_on", "cam1_vcama_off", "cam2_vcama_on", "cam2_vcama_off", "cam0_mclk_on", "cam0_mclk_off", "cam1_mclk_on", "cam1_mclk_off", "cam2_mclk_on", "cam2_mclk_off";
			status = "okay";
		};
	};

	fragment@25 {
		target = <0xffffffff>;

		__overlay__ {

			adc_channel@ {
				compatible = "mediatek,adc_channel";
				mediatek,adc_fdd_rf_params_dynamic_custom_ch = <0x2>;
				mediatek,temperature0 = <0x0>;
				mediatek,temperature1 = <0x1>;
				status = "okay";
			};
		};
	};

	fragment@26 {
		target = <0xffffffff>;

		__overlay__ {
			mediatek,clkbuf-config = <0x2 0x1 0x1 0x2 0x0 0x0 0x0>;
			mediatek,clkbuf-driving-current = <0x1 0x1 0x1 0x1 0x1 0x1 0x1>;
			mediatek,clkbuf-quantity = <0x7>;
			status = "okay";
		};
	};

	fragment@27 {
		target = <0xffffffff>;

		__overlay__ {
			#address-cells = <0x1>;
			#size-cells = <0x0>;
			clock-frequency = <0x61a80>;
			mediatek,use-open-drain;

			cap_touch@5d {
				compatible = "mediatek,cap_touch";
				linux,phandle = <0x3f>;
				phandle = <0x3f>;
				reg = <0x5d>;
				status = "okay";
			};
		};
	};

	fragment@28 {
		target = <0xffffffff>;

		__overlay__ {
			#address-cells = <0x1>;
			#size-cells = <0x0>;
			clock-frequency = <0x61a80>;
			mediatek,use-open-drain;

			gsensor@0e {
				compatible = "mediatek,gsensor";
				linux,phandle = <0x40>;
				phandle = <0x40>;
				reg = <0xe>;
				status = "okay";
			};
		};
	};

	fragment@29 {
		target = <0xffffffff>;

		__overlay__ {
			#address-cells = <0x1>;
			#size-cells = <0x0>;
			clock-frequency = <0x61a80>;
			mediatek,use-open-drain;

			camera_main@1a {
				compatible = "mediatek,camera_main";
				linux,phandle = <0x41>;
				phandle = <0x41>;
				reg = <0x1a>;
				status = "okay";
			};

			camera_main_af@0c {
				compatible = "mediatek,camera_main_af";
				linux,phandle = <0x43>;
				phandle = <0x43>;
				reg = <0xc>;
				status = "okay";
			};

			camera_main_eeprom@50 {
				compatible = "mediatek,camera_main_eeprom";
				linux,phandle = <0x42>;
				phandle = <0x42>;
				reg = <0x50>;
				status = "okay";
			};
		};
	};

	fragment@3 {
		target = <0xffffffff>;

		__overlay__ {
			#address-cells = <0x1>;
			#size-cells = <0x0>;
			clock-frequency = <0x61a80>;

			mtk-usb@60 {
				compatible = "mediatek,mtk-usb";
				reg = <0x60>;
				status = "okay";
			};
		};
	};

	fragment@30 {
		target = <0xffffffff>;

		__overlay__ {
			#address-cells = <0x1>;
			#size-cells = <0x0>;
			clock-frequency = <0x61a80>;
			mediatek,use-open-drain;

			ext_buck_lp4@57 {
				compatible = "mediatek,ext_buck_lp4";
				linux,phandle = <0x46>;
				phandle = <0x46>;
				reg = <0x57>;
				status = "okay";
			};

			ext_buck_lp4x@50 {
				compatible = "mediatek,ext_buck_lp4x";
				linux,phandle = <0x47>;
				phandle = <0x47>;
				reg = <0x50>;
				status = "okay";
			};

			nfc@08 {
				compatible = "mediatek,nfc";
				linux,phandle = <0x45>;
				phandle = <0x45>;
				reg = <0x8>;
				status = "okay";
			};

			slave_charger@4b {
				compatible = "mediatek,slave_charger";
				linux,phandle = <0x44>;
				phandle = <0x44>;
				reg = <0x4b>;
				status = "okay";
			};
		};
	};

	fragment@31 {
		target = <0xffffffff>;

		__overlay__ {
			#address-cells = <0x1>;
			#size-cells = <0x0>;
			clock-frequency = <0x186a0>;
			mediatek,use-open-drain;

			camera_sub@2d {
				compatible = "mediatek,camera_sub";
				linux,phandle = <0x49>;
				phandle = <0x49>;
				reg = <0x2d>;
				status = "okay";
			};

			camera_sub_eeprom@52 {
				compatible = "mediatek,camera_sub_eeprom";
				linux,phandle = <0x4a>;
				phandle = <0x4a>;
				reg = <0x52>;
				status = "okay";
			};

			scancontrol_i2c@64 {
				compatible = "mediatek,scancontrol_i2c";
				linux,phandle = <0x48>;
				phandle = <0x48>;
				reg = <0x64>;
				status = "okay";
			};
		};
	};

	fragment@32 {
		target = <0xffffffff>;

		__overlay__ {
			#address-cells = <0x1>;
			#size-cells = <0x0>;
			clock-frequency = <0x33e140>;
			mediatek,use-push-pull;

			subpmic_pmu@34 {
				compatible = "mediatek,subpmic_pmu";
				linux,phandle = <0x4b>;
				phandle = <0x4b>;
				reg = <0x34>;
				status = "okay";
			};

			usb_type_c@4e {
				compatible = "mediatek,usb_type_c";
				linux,phandle = <0x4c>;
				phandle = <0x4c>;
				reg = <0x4e>;
				status = "okay";
			};
		};
	};

	fragment@33 {
		target = <0xffffffff>;

		__overlay__ {
			#address-cells = <0x1>;
			#size-cells = <0x0>;
			clock-frequency = <0x61a80>;
			mediatek,use-open-drain;

			camera_main_two@2d {
				compatible = "mediatek,camera_main_two";
				linux,phandle = <0x4d>;
				phandle = <0x4d>;
				reg = <0x2d>;
				status = "okay";
			};

			camera_main_two_af@0c {
				compatible = "mediatek,camera_main_two_af";
				linux,phandle = <0x4f>;
				phandle = <0x4f>;
				reg = <0xc>;
				status = "okay";
			};

			camera_main_two_eeprom@50 {
				compatible = "mediatek,camera_main_two_eeprom";
				linux,phandle = <0x4e>;
				phandle = <0x4e>;
				reg = <0x50>;
				status = "okay";
			};

			ext_buck_vgpu@55 {
				compatible = "mediatek,ext_buck_vgpu";
				linux,phandle = <0x50>;
				phandle = <0x50>;
				reg = <0x55>;
				status = "okay";
			};
		};
	};

	fragment@34 {
		target = <0xffffffff>;

		__overlay__ {
			#address-cells = <0x1>;
			#size-cells = <0x0>;
			clock-frequency = <0x61a80>;
			mediatek,use-open-drain;
		};
	};

	fragment@35 {
		target = <0xffffffff>;

		__overlay__ {
			#address-cells = <0x1>;
			#size-cells = <0x0>;
			clock-frequency = <0x61a80>;
			mediatek,use-open-drain;
		};
	};

	fragment@36 {
		target = <0xffffffff>;

		__overlay__ {
			#address-cells = <0x1>;
			#size-cells = <0x0>;
			clock-frequency = <0x61a80>;
			mediatek,use-open-drain;
		};
	};

	fragment@37 {
		target = <0xffffffff>;

		__overlay__ {
			GPIO_SIM1_HOT_PLUG = <0xffffffff 0x2f 0x0>;
			GPIO_SIM1_SCLK = <0xffffffff 0x26 0x0>;
			GPIO_SIM1_SIO = <0xffffffff 0x28 0x0>;
			GPIO_SIM1_SRST = <0xffffffff 0x27 0x0>;
			GPIO_SIM2_SCLK = <0xffffffff 0x25 0x0>;
			GPIO_SIM2_SIO = <0xffffffff 0x23 0x0>;
			GPIO_SIM2_SRST = <0xffffffff 0x24 0x0>;
		};
	};

	fragment@38 {
		target = <0xffffffff>;

		__overlay__ {
			gpio_init_default = <0x0 0x1 0x0 0x0 0x0 0x0 0x1 0x1 0x1 0x0 0x0 0x1 0x1 0x1 0x2 0x0 0x0 0x0 0x1 0x1 0x1 0x3 0x0 0x0 0x0 0x1 0x0 0x1 0x4 0x0 0x0 0x0 0x0 0x0 0x0 0x5 0x0 0x0 0x0 0x0 0x0 0x0 0x6 0x0 0x0 0x0 0x1 0x1 0x0 0x7 0x0 0x1 0x1 0x1 0x0 0x0 0x8 0x7 0x0 0x0 0x1 0x1 0x0 0x9 0x0 0x0 0x0 0x1 0x1 0x0 0xa 0x0 0x0 0x0 0x1 0x0 0x0 0xb 0x0 0x0 0x0 0x1 0x1 0x0 0xc 0x0 0x0 0x0 0x1 0x0 0x0 0xd 0x3 0x0 0x0 0x1 0x0 0x0 0xe 0x3 0x0 0x0 0x0 0x0 0x0 0xf 0x3 0x0 0x0 0x0 0x0 0x0 0x10 0x3 0x0 0x0 0x0 0x0 0x0 0x11 0x0 0x0 0x0 0x1 0x1 0x0 0x12 0x6 0x0 0x0 0x0 0x0 0x0 0x13 0x0 0x1 0x0 0x1 0x0 0x0 0x14 0x6 0x0 0x0 0x0 0x0 0x0 0x15 0x0 0x1 0x0 0x1 0x0 0x0 0x16 0x0 0x1 0x0 0x1 0x0 0x0 0x17 0x3 0x0 0x0 0x0 0x0 0x0 0x18 0x0 0x1 0x0 0x1 0x0 0x0 0x19 0x5 0x0 0x0 0x0 0x0 0x0 0x1a 0x5 0x0 0x0 0x0 0x0 0x0 0x1b 0x5 0x0 0x0 0x0 0x0 0x0 0x1c 0x5 0x0 0x0 0x0 0x0 0x0 0x1d 0x1 0x0 0x0 0x1 0x0 0x1 0x1e 0x1 0x0 0x0 0x1 0x0 0x1 0x1f 0x1 0x0 0x0 0x1 0x0 0x1 0x20 0x1 0x0 0x0 0x1 0x0 0x1 0x21 0x1 0x0 0x0 0x1 0x0 0x1 0x22 0x1 0x0 0x0 0x1 0x0 0x1 0x23 0x1 0x0 0x0 0x1 0x1 0x0 0x24 0x1 0x0 0x0 0x0 0x0 0x0 0x25 0x1 0x0 0x0 0x0 0x0 0x0 0x26 0x1 0x0 0x0 0x0 0x0 0x0 0x27 0x1 0x0 0x0 0x0 0x0 0x0 0x28 0x1 0x0 0x0 0x1 0x1 0x0 0x29 0x0 0x0 0x0 0x1 0x1 0x0 0x2a 0x4 0x0 0x0 0x0 0x0 0x0 0x2b 0x1 0x0 0x0 0x0 0x0 0x0 0x2c 0x1 0x0 0x0 0x1 0x0 0x0 0x2d 0x1 0x0 0x0 0x0 0x0 0x0 0x2e 0x0 0x0 0x0 0x1 0x1 0x0 0x2f 0x1 0x0 0x0 0x1 0x1 0x0 0x30 0x1 0x0 0x0 0x1 0x1 0x1 0x31 0x1 0x0 0x0 0x1 0x1 0x1 0x32 0x1 0x0 0x0 0x1 0x1 0x1 0x33 0x1 0x0 0x0 0x1 0x1 0x1 0x34 0x1 0x0 0x0 0x1 0x0 0x0 0x35 0x1 0x0 0x0 0x1 0x0 0x0 0x36 0x1 0x0 0x0 0x1 0x0 0x0 0x37 0x1 0x0 0x0 0x1 0x0 0x0 0x38 0x1 0x0 0x0 0x1 0x0 0x0 0x39 0x1 0x0 0x0 0x1 0x0 0x0 0x3a 0x0 0x0 0x0 0x1 0x0 0x0 0x3b 0x1 0x0 0x0 0x1 0x0 0x0 0x3c 0x1 0x0 0x0 0x1 0x0 0x0 0x3d 0x1 0x0 0x0 0x1 0x0 0x0 0x3e 0x1 0x0 0x0 0x1 0x0 0x0 0x3f 0x1 0x0 0x0 0x1 0x0 0x0 0x40 0x1 0x0 0x0 0x1 0x0 0x0 0x41 0x1 0x0 0x0 0x1 0x0 0x0 0x42 0x1 0x0 0x0 0x1 0x0 0x0 0x43 0x1 0x0 0x0 0x1 0x0 0x0 0x44 0x1 0x0 0x0 0x1 0x0 0x0 0x45 0x1 0x0 0x0 0x1 0x0 0x0 0x46 0x1 0x0 0x0 0x1 0x0 0x0 0x47 0x1 0x0 0x0 0x1 0x0 0x0 0x48 0x1 0x0 0x0 0x1 0x0 0x0 0x49 0x1 0x0 0x0 0x1 0x0 0x0 0x4a 0x1 0x0 0x0 0x1 0x0 0x0 0x4b 0x1 0x0 0x0 0x1 0x0 0x0 0x4c 0x1 0x0 0x0 0x1 0x0 0x0 0x4d 0x1 0x0 0x0 0x1 0x0 0x0 0x4e 0x1 0x0 0x0 0x1 0x0 0x0 0x4f 0x1 0x0 0x0 0x1 0x0 0x0 0x50 0x1 0x0 0x0 0x1 0x0 0x0 0x51 0x1 0x0 0x0 0x1 0x1 0x1 0x52 0x1 0x0 0x0 0x1 0x1 0x1 0x53 0x1 0x0 0x0 0x1 0x1 0x1 0x54 0x1 0x0 0x0 0x1 0x1 0x1 0x55 0x1 0x0 0x0 0x1 0x0 0x0 0x56 0x1 0x0 0x0 0x1 0x0 0x0 0x57 0x0 0x1 0x1 0x1 0x0 0x0 0x58 0x0 0x1 0x0 0x1 0x0 0x0 0x59 0x1 0x0 0x0 0x1 0x0 0x0 0x5a 0x2 0x0 0x0 0x0 0x0 0x0 0x5b 0x1 0x0 0x0 0x0 0x0 0x0 0x5c 0x1 0x0 0x0 0x0 0x0 0x0 0x5d 0x1 0x0 0x0 0x1 0x1 0x0 0x5e 0x1 0x0 0x0 0x1 0x1 0x0 0x5f 0x1 0x0 0x0 0x1 0x1 0x0 0x60 0x1 0x0 0x0 0x0 0x0 0x0 0x61 0x0 0x1 0x0 0x1 0x0 0x0 0x62 0x0 0x1 0x0 0x1 0x0 0x0 0x63 0x1 0x0 0x0 0x0 0x0 0x0 0x64 0x1 0x0 0x0 0x0 0x0 0x0 0x65 0x0 0x1 0x1 0x1 0x0 0x0 0x66 0x0 0x1 0x1 0x1 0x0 0x0 0x67 0x1 0x0 0x0 0x1 0x1 0x1 0x68 0x1 0x0 0x0 0x0 0x0 0x1 0x69 0x1 0x0 0x0 0x0 0x0 0x1 0x6a 0x1 0x0 0x0 0x1 0x1 0x1 0x6b 0x4 0x0 0x0 0x1 0x1 0x0 0x6c 0x4 0x0 0x0 0x1 0x1 0x0 0x6d 0x4 0x0 0x0 0x1 0x1 0x0 0x6e 0x0 0x0 0x0 0x1 0x0 0x0 0x6f 0x0 0x0 0x0 0x1 0x0 0x0 0x70 0x0 0x0 0x0 0x1 0x0 0x0 0x71 0x0 0x0 0x0 0x1 0x0 0x0 0x72 0x0 0x0 0x0 0x1 0x0 0x0 0x73 0x0 0x0 0x0 0x1 0x0 0x0 0x74 0x0 0x0 0x0 0x1 0x0 0x0 0x75 0x0 0x0 0x0 0x1 0x0 0x0 0x76 0x0 0x0 0x0 0x1 0x0 0x0 0x77 0x0 0x0 0x0 0x1 0x0 0x0 0x78 0x0 0x0 0x0 0x1 0x0 0x0 0x79 0x0 0x0 0x0 0x1 0x0 0x0 0x86 0x1 0x0 0x0 0x1 0x0 0x1 0x87 0x1 0x0 0x0 0x0 0x0 0x0 0x88 0x1 0x0 0x0 0x0 0x0 0x0 0x89 0x1 0x0 0x0 0x0 0x0 0x0 0x8a 0x1 0x0 0x0 0x0 0x0 0x0 0x8b 0x1 0x0 0x0 0x0 0x0 0x0 0x8c 0x1 0x0 0x0 0x1 0x0 0x0 0x8d 0x1 0x0 0x0 0x1 0x0 0x0 0x8e 0x1 0x0 0x0 0x1 0x0 0x0 0x8f 0x1 0x0 0x0 0x1 0x0 0x0 0x90 0x1 0x0 0x0 0x1 0x0 0x0 0x91 0x1 0x0 0x0 0x0 0x0 0x0 0x92 0x1 0x0 0x0 0x1 0x0 0x0 0x93 0x1 0x0 0x0 0x0 0x0 0x0 0x94 0x1 0x0 0x0 0x0 0x0 0x0 0x95 0x1 0x0 0x0 0x0 0x0 0x0 0x96 0x6 0x0 0x0 0x1 0x1 0x0 0x97 0x6 0x0 0x0 0x1 0x0 0x0 0x98 0x0 0x1 0x0 0x1 0x0 0x0 0x99 0x0 0x1 0x0 0x1 0x0 0x0 0x9a 0x0 0x1 0x0 0x1 0x0 0x0 0x9b 0x0 0x1 0x1 0x1 0x0 0x0 0x9c 0x7 0x0 0x0 0x1 0x0 0x0 0x9d 0x7 0x0 0x0 0x1 0x0 0x0 0x9e 0x7 0x0 0x0 0x1 0x0 0x0 0x9f 0x0 0x1 0x0 0x1 0x0 0x0 0xa0 0x0 0x1 0x0 0x1 0x0 0x0 0xa1 0x4 0x0 0x0 0x1 0x1 0x1 0xa2 0x1 0x0 0x0 0x1 0x1 0x1 0xa3 0x0 0x0 0x0 0x0 0x0 0x0 0xa4 0x0 0x0 0x0 0x0 0x0 0x0 0xa5 0x0 0x0 0x0 0x1 0x0 0x0 0xa6 0x0 0x1 0x1 0x1 0x0 0x0 0xa7 0x0 0x0 0x0 0x1 0x0 0x0 0xa8 0x0 0x0 0x0 0x1 0x0 0x0 0xa9 0x0 0x1 0x1 0x1 0x0 0x0 0xaa 0x0 0x1 0x0 0x1 0x0 0x0 0xab 0x0 0x1 0x0 0x1 0x0 0x0 0xac 0x0 0x1 0x1 0x1 0x0 0x0 0xad 0x0 0x1 0x0 0x1 0x0 0x0 0xae 0x0 0x1 0x1 0x1 0x0 0x0 0xaf 0x0 0x1 0x0 0x1 0x0 0x0 0xb0 0x0 0x1 0x0 0x1 0x0 0x0 0xb1 0x0 0x1 0x0 0x1 0x0 0x0 0xb2 0x0 0x1 0x0 0x1 0x0 0x0 0xb3 0x0 0x0 0x0 0x1 0x0 0x0>;
		};
	};

	fragment@39 {
		target = <0xffffffff>;

		__overlay__ {
			interrupt-parent = <0xffffffff>;
			interrupts = <0x2 0x2 0x2 0x0>;
			status = "okay";
		};
	};

	fragment@4 {
		target = <0xffffffff>;

		__overlay__ {

			ext_buck_lp4@57 {
				regulator-max-microvolt = <0x13d620>;
				regulator-min-microvolt = <0x493e0>;
				regulator-name = "ext_buck_vdd2";
				vsel_pin = <0x0>;
			};

			ext_buck_lp4x@50 {
				regulator-max-microvolt = <0x13d620>;
				regulator-min-microvolt = <0x493e0>;
				regulator-name = "ext_buck_vddq";
				vsel_pin = <0x1>;
			};
		};
	};

	fragment@40 {
		target = <0xffffffff>;

		__overlay__ {
			interrupt-parent = <0xffffffff>;
			interrupts = <0xa 0x4 0xa 0x0>;
			status = "okay";
		};
	};

	fragment@41 {
		target = <0xffffffff>;

		__overlay__ {
			interrupt-parent = <0xffffffff>;
			interrupts = <0xb 0x2 0xb 0x0>;
			status = "okay";
		};
	};

	fragment@42 {
		target = <0xffffffff>;

		__overlay__ {
			interrupt-parent = <0xffffffff>;
			interrupts = <0x29 0x8 0x29 0x0>;
			status = "okay";
		};
	};

	fragment@43 {
		target = <0xffffffff>;

		__overlay__ {
			interrupt-parent = <0xffffffff>;
			interrupts = <0x2c 0x1 0x2c 0x1>;
			status = "okay";
		};
	};

	fragment@44 {
		target = <0xffffffff>;

		__overlay__ {
			interrupt-parent = <0xffffffff>;
			interrupts = <0x2e 0x8 0x2e 0x0>;
			status = "okay";
		};
	};

	fragment@45 {
		target = <0xffffffff>;

		__overlay__ {
			interrupt-parent = <0xffffffff>;
			interrupts = <0x90 0x4 0x90 0x1>;
			status = "okay";
		};
	};

	fragment@46 {
		target = <0xffffffff>;

		__overlay__ {
			compatible = "mediatek,md1_sim1_hot_plug_eint-eint";
			debounce = <0x0 0x186a0>;
			dedicated = <0x0 0x0>;
			interrupts = <0x0 0x4>;
			sockettype = <0x0 0x0>;
			src_pin = <0x0 0x1>;
			status = "okay";
		};
	};

	fragment@47 {
		target = <0xffffffff>;

		__overlay__ {
			regulator-default-on = <0x1>;
			regulator-name = "vcama";
			status = "okay";
		};
	};

	fragment@48 {
		target = <0xffffffff>;

		__overlay__ {
			regulator-default-on = <0x1>;
			regulator-name = "vsim1";
			status = "okay";
		};
	};

	fragment@49 {
		target = <0xffffffff>;

		__overlay__ {
			regulator-default-on = <0x1>;
			regulator-name = "vsim2";
			status = "okay";
		};
	};

	fragment@5 {
		target = <0xffffffff>;

		__overlay__ {

			ext_buck_vgpu@55 {
				regulator-max-microvolt = <0x13d620>;
				regulator-min-microvolt = <0x493e0>;
				regulator-name = "ext_buck_vgpu";
				vsel_pin = <0x2>;
			};
		};
	};

	fragment@50 {
		target = <0xffffffff>;

		__overlay__ {
			regulator-default-on = <0x1>;
			regulator-name = "vcamd";
			status = "okay";
		};
	};

	fragment@51 {
		target = <0xffffffff>;

		__overlay__ {
			regulator-default-on = <0x1>;
			regulator-name = "vcamio";
			status = "okay";
		};
	};

	fragment@52 {
		target = <0xffffffff>;

		__overlay__ {
			regulator-default-on = <0x1>;
			regulator-name = "vldo28";
			status = "okay";
		};
	};

	fragment@53 {
		target = <0xffffffff>;

		__overlay__ {
			status = "okay";
			vcama-supply = <0xffffffff>;
			vcamaf-supply = <0xffffffff>;
			vcamaf_main2-supply = <0xffffffff>;
			vcamaf_sub-supply = <0xffffffff>;
			vcamd_main2-supply = <0xffffffff>;
			vcamio-supply = <0xffffffff>;
			vcamio_main2-supply = <0xffffffff>;
			vcamio_sub-supply = <0xffffffff>;
		};
	};

	fragment@54 {
		target = <0xffffffff>;

		__overlay__ {
			status = "okay";
			vtouch-supply = <0xffffffff>;
		};
	};

	fragment@55 {
		target = <0xffffffff>;

		__overlay__ {
			mediatek,kpd-hw-dl-key2 = <0x27>;
			mediatek,kpd-hw-factory-key = <0x27>;
			mediatek,kpd-hw-init-map = <0x3c 0x3d 0x0 0x0 0x0 0x0 0x0 0x0 0x0 0x0 0x0 0x0 0x0 0x0 0x0 0x0 0x0 0x0 0x0 0x0 0x0 0x0 0x0 0x0 0x0 0x0 0x0 0x0 0x0 0x0 0x0 0x0 0x0 0x0 0x0 0x0 0x0 0x0 0x0 0x72 0x73 0x0 0x0 0x0 0x0 0x0 0x0 0x0 0x0 0x0 0x0 0x0 0x0 0x0 0x0 0x0 0x0 0x0 0x0 0x0 0x0 0x0 0x0 0x0 0x0 0x0 0x0 0x0 0x0 0x0 0x0 0x0>;
			mediatek,kpd-hw-map-num = <0x48>;
			mediatek,kpd-hw-pwrkey = <0x8>;
			mediatek,kpd-key-debounce = <0x400>;
			mediatek,kpd-pwkey-gpio-din = <0x0>;
			mediatek,kpd-pwrkey-eint-gpio = <0x0>;
			mediatek,kpd-sw-pwrkey = <0x74>;
			mediatek,kpd-use-extend-type = <0x0>;
			status = "okay";
		};
	};

	fragment@56 {
		target = <0xffffffff>;

		__overlay__ {
			gpio-base = <0xffffffff 0x0 0x0>;
			interrupt-parent = <0xffffffff>;
			interrupts = <0x11 0x3 0x11 0x0 0x1 0x1 0x1 0x0>;
			ldo_vaud28-supply = <0xffffffff>;
			ldo_vaux18-supply = <0xffffffff>;
			ldo_vcama-supply = <0xffffffff>;
			ldo_vcamd-supply = <0xffffffff>;
			ldo_vcamio-supply = <0xffffffff>;
			ldo_vcn28-supply = <0xffffffff>;
			ldo_vcn33_bt-supply = <0xffffffff>;
			ldo_vcn33_wifi-supply = <0xffffffff>;
			ldo_vdram-supply = <0xffffffff>;
			ldo_vefuse-supply = <0xffffffff>;
			ldo_vemc-supply = <0xffffffff>;
			ldo_vfe28-supply = <0xffffffff>;
			ldo_vibr-supply = <0xffffffff>;
			ldo_vio18-supply = <0xffffffff>;
			ldo_vio28-supply = <0xffffffff>;
			ldo_vldo28-supply = <0xffffffff>;
			ldo_vmc-supply = <0xffffffff>;
			ldo_vmch-supply = <0xffffffff>;
			ldo_vrf12-supply = <0xffffffff>;
			ldo_vrf18-supply = <0xffffffff>;
			ldo_vsim1-supply = <0xffffffff>;
			ldo_vsim2-supply = <0xffffffff>;
			ldo_vsram_others-supply = <0xffffffff>;
			ldo_vsram_proc-supply = <0xffffffff>;
			ldo_vusb33-supply = <0xffffffff>;
			ldo_vxo22-supply = <0xffffffff>;
			status = "okay";

			gpio-keys {
				compatible = "gpio-keys";

				scan {
					debounce = <0x2710>;
					interrupt-parent = <0xffffffff>;
					interrupts = <0x8 0x8 0x8 0x0>;
					linux,code = <0x3b>;
					status = "okay";
					wakeup;
				};
			};

			gpio-switch-dev {
				compatible = "gpio-switch-dev";

				eint_switch1 {
					debounce = <0x2710>;
					interrupt-parent = <0xffffffff>;
					interrupts = <0x9 0x8 0x9 0x0>;
					status = "okay";
				};
			};
		};
	};

	fragment@6 {
		target = <0xffffffff>;

		__overlay__ {
			pinctrl-0 = <0x1>;
			pinctrl-1 = <0x2>;
			pinctrl-2 = <0x3>;
			pinctrl-3 = <0x4>;
			pinctrl-4 = <0x5>;
			pinctrl-5 = <0x6>;
			pinctrl-names = "default", "state_eint_as_int", "state_eint_output0", "state_eint_output1", "state_rst_output0", "state_rst_output1";
			status = "okay";
			tpd-filter-custom-prameters = <0x0 0x0 0x0 0x0 0x0 0x0 0x0 0x0 0x0 0x0 0x0 0x0>;
			tpd-filter-custom-speed = <0x0 0x0 0x0>;
			tpd-filter-enable = <0x1>;
			tpd-filter-pixel-density = <0x6a>;
			tpd-key-dim-local = <0x5a 0x373 0x64 0x28 0xe6 0x373 0x64 0x28 0x172 0x373 0x64 0x28 0x0 0x0 0x0 0x0>;
			tpd-key-local = <0x8b 0xac 0x9e 0x0>;
			tpd-key-num = <0x3>;
			tpd-max-touch-num = <0x5>;
			tpd-resolution = <0x2d0 0x500>;
			use-tpd-button = <0x0>;
		};
	};

	fragment@7 {
		target = <0xffffffff>;

		__overlay__ {

			eint0default {
				linux,phandle = <0x1>;
				phandle = <0x1>;
			};

			eint@0 {
				linux,phandle = <0x2>;
				phandle = <0x2>;

				pins_cmd_dat {
					bias-disable;
					pinmux = <0x200>;
					slew-rate = <0x0>;
				};
			};

			eintoutput0 {
				linux,phandle = <0x3>;
				phandle = <0x3>;

				pins_cmd_dat {
					output-low;
					pinmux = <0x200>;
					slew-rate = <0x1>;
				};
			};

			eintoutput1 {
				linux,phandle = <0x4>;
				phandle = <0x4>;

				pins_cmd_dat {
					output-high;
					pinmux = <0x200>;
					slew-rate = <0x1>;
				};
			};

			rstoutput0 {
				linux,phandle = <0x5>;
				phandle = <0x5>;

				pins_cmd_dat {
					output-low;
					pinmux = <0xae00>;
					slew-rate = <0x1>;
				};
			};

			rstoutput1 {
				linux,phandle = <0x6>;
				phandle = <0x6>;

				pins_cmd_dat {
					output-high;
					pinmux = <0xae00>;
					slew-rate = <0x1>;
				};
			};
		};
	};

	fragment@8 {
		target = <0xffffffff>;

		__overlay__ {
			accdet-mic-mode = <0x1>;
			accdet-mic-vol = <0x6>;
			accdet-plugout-debounce = <0x1>;
			headset-eint-level-pol = <0x8>;
			headset-four-key-threshold = <0x0 0x3a 0x79 0xc0 0x190>;
			headset-mode-setting = <0x500 0x500 0x1 0x1f0 0x800 0x800 0x20 0x44>;
			headset-three-key-threshold = <0x0 0x50 0xdc 0x190>;
			headset-three-key-threshold-CDD = <0x0 0x79 0xc0 0x258>;
			pinctrl-0 = <0x7>;
			pinctrl-1 = <0x8>;
			pinctrl-names = "default", "state_eint_as_int";
			status = "okay";
		};
	};

	fragment@9 {
		target = <0xffffffff>;

		__overlay__ {

			accdetdefault {
				linux,phandle = <0x7>;
				phandle = <0x7>;
			};

			accdeteint@0 {
				linux,phandle = <0x8>;
				phandle = <0x8>;

				pins_cmd_dat {
					bias-disable;
					pinmux = <0x900>;
					slew-rate = <0x0>;
				};
			};
		};
	};
};
